/*
 * Stand-in linker memory definitions.
 * Soon, this file will be automatically generated by SimpleSoc.
 */

MEMORY
{
	rom : ORIGIN = 0x00000000, LENGTH = 0x1000
	ram : ORIGIN = 0x10000000, LENGTH = 0x1000
}
